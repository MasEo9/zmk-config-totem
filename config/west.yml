## config/west.yml
```yaml
manifest:
  defaults:
    revision: v0.3
  remotes:
    - name: zmkfirmware
      url-base: https://github.com/zmkfirmware
    - name: urob
      url-base: https://github.com/urob

  projects:
    - name: zmk
      remote: zmkfirmware
      import: app/west.yml
      revision: v0.2

    - name: zmk-helpers
      remote: urob
      revision: main

  self:
    path: config
```
